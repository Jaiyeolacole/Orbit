## components/chat_client/Kconfig
```kconfig
menu "OpenAI Chat Client Configuration"

    config OPENAI_API_KEY
        string "OpenAI API key"
        default "sk - proj - JHXwiyvGbcpzF_hq2X8duXQdrifuqDRpe - B6azOpv_O5J05RyndMUjkyvPu826NSjNxmtg3wykT3BlbkFJSPUHapnmJADFy3KWJHYeuDgboO_nnRQAFV6ncP9iHO3_ - OxiLuNWu8GudtahagR8Gv6I05CSgA"
        help
            Your OpenAI API key (https://platform.openai.com/api-keys).
            Required - chat_client_init() fails if this is left empty.
            For real deployments, set this via a local (git-ignored)
            sdkconfig rather than committing it to version control.

    config OPENAI_BASE_URL
        string "OpenAI API base URL override (leave empty for default)"
        default ""
        help
            Override the API base URL, e.g. to point at an OpenAI-compatible
            proxy or self-hosted endpoint. Leave empty to use the OpenAI
            component's built-in default (api.openai.com).

    config OPENAI_MODEL
        string "Chat model"
        default "gpt-4o-mini"
        help
            Model name passed to setModel(), e.g. gpt-4o-mini, gpt-4.1,
            gpt-3.5-turbo.

    config OPENAI_SYSTEM_PROMPT
        string "System prompt"
        default "You are a helpful assistant running on an ESP32."
        help
            System prompt sent once via setSystem() and kept for the life
            of the chat completion object.

    config OPENAI_MAX_TOKENS
        int "Max response tokens"
        default 256
        range 1 4096

    config OPENAI_TEMPERATURE
        int "Temperature x100"
        default 70
        range 0 200
        help
            Sampling temperature multiplied by 100 (Kconfig has no float
            type). 70 -> 0.70. Divided back to a float in chat_client.c
            before calling setTemperature().

    config OPENAI_TOP_P
        int "Top-p x100"
        default 100
        range 0 100
        help
            Nucleus sampling probability mass multiplied by 100.
            100 -> 1.0.

    config OPENAI_PRESENCE_PENALTY
        int "Presence penalty x100"
        default 0
        range -200 200
        help
            OpenAI accepts -2.0..2.0; this is that value multiplied by 100.

    config OPENAI_FREQUENCY_PENALTY
        int "Frequency penalty x100"
        default 0
        range -200 200
        help
            OpenAI accepts -2.0..2.0; this is that value multiplied by 100.

    config OPENAI_USER_ID
        string "User identifier sent to OpenAI"
        default "esp32-user"
        help
            Passed to setUser(); helps OpenAI's abuse-monitoring tools
            distinguish end users.

    config OPENAI_SAVE_HISTORY
        bool "Keep conversation history between messages"
        default y
        help
            When enabled, each chat_client_send() call passes save=true to
            message(), so prior turns stay in context for follow-up
            questions. Uses more RAM/bandwidth per turn as the conversation
            grows; call chat_client_reset_conversation() to clear it.

endmenu
```

## components/wifi_manager/Kconfig
```kconfig
menu "Wi-Fi Manager Configuration"

    config WIFI_SSID
        string "Wi-Fi SSID"
        default "momentum"
        help
            SSID (network name) that the device should connect to.

    config WIFI_PASSWORD
        string "Wi-Fi Password"
        default "iamalive"
        help
            WPA/WPA2 password for the SSID above. For real deployments,
            override this via a local (git-ignored) sdkconfig rather than
            committing real credentials here.

    config WIFI_MAXIMUM_RETRY
        int "Maximum connection retries"
        default 5
        range 0 20
        help
            Number of reconnection attempts after a disconnect before
            wifi_manager_connect() gives up and returns ESP_FAIL.

endmenu
```

## main/Kconfig.projbuild
```kconfig
menu "Chat App Configuration"

    config APP_WIFI_CONNECT_TIMEOUT_MS
        int "Wi-Fi connect timeout (milliseconds)"
        default 15000
        range 1000 120000
        help
            How long app_main() waits for wifi_manager_connect() to bring up
            a station connection before giving up and aborting startup.

    config APP_CHAT_INPUT_BUFFER_SIZE
        int "Max characters per typed chat line"
        default 512
        range 32 4096
        help
            Size of the line buffer used to read a user's message from the
            console (UART) before it is handed to the chat client.

    config APP_TASK_STACK_SIZE
        int "Chat task stack size (bytes)"
        default 8192
        range 4096 32768
        help
            Stack size for the FreeRTOS task that runs the chat REPL and
            talks to the OpenAI component. The TLS client is stack-hungry;
            don't go too low or you'll see stack canary crashes.

    config APP_TASK_PRIORITY
        int "Chat task priority"
        default 5
        range 1 24

endmenu
```
